## build_nrf52dk_nrf52832/Kconfig/Kconfig.modules
```kconfig
osource "/home/johangarrido/ncs/nrf/Kconfig.nrf"

osource "/home/johangarrido/ncs/bootloader/mcuboot/zephyr/Kconfig"

osource "/home/johangarrido/ncs/nrfxlib/Kconfig.nrfxlib"
```

## build_nrf52dk_nrf52832/Kconfig/Kconfig.shield
```kconfig
osource "/home/johangarrido/ncs/nrf/boards/shields/*/Kconfig.shield"
osource "/home/johangarrido/ncs/zephyr/boards/shields/*/Kconfig.shield"
```

## build_nrf52dk_nrf52832/Kconfig/Kconfig.shield.defconfig
```kconfig
osource "/home/johangarrido/ncs/nrf/boards/shields/*/Kconfig.defconfig"
osource "/home/johangarrido/ncs/zephyr/boards/shields/*/Kconfig.defconfig"
```

## build_nrf52dk_nrf52832/Kconfig/Kconfig.soc.arch
```kconfig
osource "/home/johangarrido/ncs/zephyr/soc/$(ARCH)/Kconfig"
osource "/home/johangarrido/ncs/zephyr/soc/$(ARCH)/*/Kconfig"
```
